## components/sensor_manager/Kconfig
```kconfig
menu "Sensor Manager"

config SENSOR_MANAGER_PUBLISH_INTERVAL_MS
    int "Sensor telemetry publish interval (ms)"
    default 2000
    range 1000 600000
    help
        Interval at which the sensor manager aggregates registered sensor readings
        and publishes a telemetry payload via MQTT for app monitoring.
        Default is 2000ms (2 seconds) for responsive app updates.
        Minimum: 1000ms (1 second), Maximum: 600000ms (10 minutes).

endmenu
```

## main/Kconfig.projbuild
```kconfig
menu "Korvo1 LED Audio Test"

config LED_AUDIO_STRIP_GPIO
    int "WS2812 data GPIO"
    default 19
    help
        GPIO that feeds the built-in Korvo WS2812 ring. GPIO19 is routed to the
        factory LED chain on Korvo-1 production boards.

config LED_AUDIO_LED_COUNT
    int "Number of pixels"
    default 12
    range 1 64
    help
        Total number of addressable LEDs on the Korvo-1 ring.

config LED_AUDIO_BRIGHTNESS
    int "Brightness (0-255)"
    default 64
    range 1 255
    help
        Global brightness scalar applied to every RGB value before writing it to the strip.

config AUDIO_SAMPLE_RATE
    int "Audio sample rate (Hz)"
    default 44100
    range 8000 48000
    help
        Sample rate for audio playback.

config LOG_SWEEP_DURATION_SEC
    int "Log sweep duration (seconds)"
    default 5
    range 1 30
    help
        Duration of the logarithmic frequency sweep test tone.

config LOG_SWEEP_START_FREQ
    int "Log sweep start frequency (Hz)"
    default 20
    range 20 20000
    help
        Starting frequency for the logarithmic sweep.

config LOG_SWEEP_END_FREQ
    int "Log sweep end frequency (Hz)"
    default 20000
    range 20 20000
    help
        Ending frequency for the logarithmic sweep.

    menu "Voice Assistant Configuration"
        config GEMINI_API_KEY
            string "Google Gemini API Key"
            default ""
            help
                Google Gemini API key for STT, LLM, and TTS functionality.
                Get your API key from: https://console.cloud.google.com/
                Enable APIs: Speech-to-Text, Generative Language (Gemini), Text-to-Speech

        config GEMINI_MODEL
            string "Gemini Model"
            default "gemini-2.5-flash"
            help
                Gemini model to use: "gemini-2.5-flash" (recommended), "gemini-2.5-pro", or "gemini-2.0-flash"

        config WIFI_SSID
            string "WiFi SSID"
            default ""
            help
                WiFi network SSID for internet connectivity (required for Gemini API)

        config WIFI_PASSWORD
            string "WiFi Password"
            default ""
            help
                WiFi network password

        config ENV_LLM_TTS_ENABLED
            bool "Enable LLM-TTS for environmental reports"
            default y
            help
                Enable LLM (Large Language Model) and TTS (Text-to-Speech) for environmental reports.
                When enabled, environmental reports will use Gemini LLM to generate natural language
                summaries and speak them via TTS. When disabled, reports will only be logged.
    endmenu

endmenu
```

## sdkconfig.defaults
```kconfig
CONFIG_LED_AUDIO_STRIP_GPIO=19
CONFIG_LED_AUDIO_LED_COUNT=12
CONFIG_LED_AUDIO_BRIGHTNESS=64
CONFIG_AUDIO_SAMPLE_RATE=44100
CONFIG_LOG_SWEEP_DURATION_SEC=5
CONFIG_LOG_SWEEP_START_FREQ=20
CONFIG_LOG_SWEEP_END_FREQ=20000
# Use 16MB flash (KORVO1 has 16MB flash)
CONFIG_ESPTOOLPY_FLASHSIZE_16MB=y
CONFIG_ESPTOOLPY_FLASHSIZE="16MB"
# Use custom partition table to fit embedded WAV file
CONFIG_PARTITION_TABLE_CUSTOM=y
CONFIG_PARTITION_TABLE_CUSTOM_FILENAME="partitions.csv"
CONFIG_PARTITION_TABLE_SINGLE_APP_LARGE=n
CONFIG_PARTITION_TABLE_SINGLE_APP=n

# Gemini API Configuration (from sample/voice assistant)
CONFIG_GEMINI_API_KEY="AIzaSyCjrdIBkpGWGXa4u9UileFFIMBZ_ZnMZ1w"
CONFIG_GEMINI_MODEL="gemini-2.5-flash"

# WiFi Configuration
CONFIG_WIFI_SSID="The Chateau"
CONFIG_WIFI_PASSWORD="thechateau"

# Set target to ESP32-S3 (Korvo1 has ESP32-S3, not ESP32)
CONFIG_IDF_TARGET="esp32s3"

# Enable PSRAM (8MB external RAM) - required for TTS buffers
# ESP32-S3-WROOM-1 uses Octal SPI PSRAM (8-line interface)
# Reference: https://github.com/espressif/esp-skainet/blob/master/docs/en/hw-reference/esp32s3/user-guide-korvo-1.md
CONFIG_SPIRAM=y
CONFIG_SPIRAM_MODE_OCT=y
CONFIG_SPIRAM_TYPE_AUTO=y
CONFIG_SPIRAM_SPEED_80M=y
CONFIG_SPIRAM_USE_MALLOC=y
CONFIG_SPIRAM_MALLOC_ALWAYSINTERNAL=16384
CONFIG_SPIRAM_TRY_ALLOCATE_WIFI_LWIP=y
CONFIG_SPIRAM_MALLOC_RESERVE_INTERNAL=32768
CONFIG_SPIRAM_USE_CAPS_ALLOC=y
CONFIG_SPIRAM_MEMTEST=y
# Note: CONFIG_SPIRAM_MALLOC_PREFER_EXTERNAL is not available in ESP-IDF 5.4
# PSRAM preference is handled via heap_caps_malloc with MALLOC_CAP_SPIRAM

# Increase main task stack size to prevent stack overflow during TTS
CONFIG_ESP_MAIN_TASK_STACK_SIZE=16384

# WiFi Configuration - disable AP mode features we don't need
CONFIG_ESP_WIFI_SOFTAP_BEACON_MAX_LEN=752

# Bluetooth Configuration for BLE WiFi onboarding
CONFIG_BT_ENABLED=y
CONFIG_BT_NIMBLE_ENABLED=y
CONFIG_BT_BLE_ENABLED=y
CONFIG_BT_NIMBLE_ROLE_PERIPHERAL=y
CONFIG_BT_NIMBLE_ROLE_BROADCASTER=y
CONFIG_BT_NIMBLE_EXT_ADV=n
CONFIG_BT_NIMBLE_MAX_CONNECTIONS=1
CONFIG_BT_NIMBLE_MEM_ALLOC_MODE_INTERNAL=y

# Increase watchdog timeout for initialization (default is 5 seconds)
CONFIG_ESP_TASK_WDT_TIMEOUT_S=30

# Disable mbedTLS certificate verification requirement for development
# This allows HTTPS connections without certificate verification
CONFIG_MBEDTLS_CERTIFICATE_BUNDLE=n
CONFIG_MBEDTLS_CERTIFICATE_BUNDLE_DEFAULT_FULL=n
# Enable insecure TLS mode (required for ESP_TLS_SKIP_SERVER_CERT_VERIFY)
CONFIG_ESP_TLS_INSECURE=y
# Enable skipping server certificate verification (required to avoid "No server verification option set" error)
# This sets MBEDTLS_SSL_VERIFY_NONE when no CA cert is provided
CONFIG_ESP_TLS_SKIP_SERVER_CERT_VERIFY=y

# Enable LLM-TTS for environmental reports
CONFIG_ENV_LLM_TTS_ENABLED=y

# Memory optimizations for TLS and wake word
CONFIG_SOC_SHA_DMA_MAX_BUFFER_SIZE=32768
CONFIG_MBEDTLS_SSL_IN_CONTENT_LEN=12288
CONFIG_MBEDTLS_SSL_OUT_CONTENT_LEN=4096
```
